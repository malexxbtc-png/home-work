#include "ssd1306.h"

#include <stdbool.h>
#include <string.h>
#include "esp_log.h"

#define OLED_WIDTH 128
#define OLED_HEIGHT 64
#define OLED_TIMEOUT_MS 100

struct ssd1306_device {
    i2c_master_dev_handle_t i2c;
    uint8_t framebuffer[OLED_WIDTH * OLED_HEIGHT / 8];
};

static const char *TAG = "ssd1306";

/* Шрифт 5x7 для ASCII 0x20..0x7F. Стовпці зліва направо, біт 0 = верхній рядок;
   біт 7 використовують нижні виносні елементи (g, j, p, q, y). Код 0x7F = знак градуса. */
static const uint8_t font5x7[96][5] = {
    {0x00, 0x00, 0x00, 0x00, 0x00},
    {0x00, 0x00, 0x5F, 0x00, 0x00},
    {0x00, 0x07, 0x00, 0x07, 0x00},
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    {0x00, 0x06, 0x09, 0x09, 0x06}
};

static const uint8_t *glyph_for(char c)
{
    unsigned char u = (unsigned char)c;
    if (u < 0x20 || u > 0x7F) {
        u = '?';
    }
    return font5x7[u - 0x20];
}

static esp_err_t send_commands(ssd1306_handle_t handle, const uint8_t *commands, size_t count)
{
    uint8_t buffer[32];
    if (handle == NULL || count + 1 > sizeof(buffer)) {
        return ESP_ERR_INVALID_ARG;
    }
    buffer[0] = 0x00;
    memcpy(&buffer[1], commands, count);
    return i2c_master_transmit(handle->i2c, buffer, count + 1, OLED_TIMEOUT_MS);
}

esp_err_t ssd1306_init(i2c_master_bus_handle_t bus, uint16_t address, ssd1306_handle_t *handle)
{
    if (bus == NULL || handle == NULL) {
        return ESP_ERR_INVALID_ARG;
    }

    static struct ssd1306_device device;
    const i2c_device_config_t config = {
        .dev_addr_length = I2C_ADDR_BIT_LEN_7,
        .device_address = address,
        .scl_speed_hz = 400000,
    };
    esp_err_t err = i2c_master_bus_add_device(bus, &config, &device.i2c);
    if (err != ESP_OK) {
        return err;
    }

    *handle = &device;
    const uint8_t init_commands[] = {
        0xAE, 0xD5, 0x80, 0xA8, 0x3F, 0xD3, 0x00, 0x40,
        0x8D, 0x14, 0x20, 0x00, 0xA1, 0xC8, 0xDA, 0x12,
        0x81, 0xCF, 0xD9, 0xF1, 0xDB, 0x40, 0xA4, 0xA6, 0xAF,
    };
    err = send_commands(*handle, init_commands, sizeof(init_commands));
    if (err == ESP_OK) {
        ssd1306_clear(*handle, false);
        ssd1306_show(*handle);
    }
    return err;
}

void ssd1306_clear(ssd1306_handle_t handle, bool color)
{
    if (handle != NULL) {
        memset(handle->framebuffer, color ? 0xFF : 0x00, sizeof(handle->framebuffer));
    }
}

static void draw_pixel(ssd1306_handle_t handle, int x, int y)
{
    if (x >= 0 && x < OLED_WIDTH && y >= 0 && y < OLED_HEIGHT) {
        handle->framebuffer[(y / 8) * OLED_WIDTH + x] |= (uint8_t)(1U << (y % 8));
    }
}

void ssd1306_draw_string(ssd1306_handle_t handle, int x, int y, const char *text)
{
    ssd1306_draw_string_scaled(handle, x, y, text, 1);
}

/* Збільшений текст: кожен піксель шрифту малюється квадратом scale x scale */
void ssd1306_draw_string_scaled(ssd1306_handle_t handle, int x, int y, const char *text, int scale)
{
    if (handle == NULL || text == NULL || scale < 1) {
        return;
    }
    for (; *text != '\0'; ++text, x += 6 * scale) {
        const uint8_t *glyph = glyph_for(*text);
        for (int column = 0; column < 5; ++column) {
            for (int row = 0; row < 8; ++row) {
                if ((glyph[column] & (1U << row)) == 0) {
                    continue;
                }
                for (int dx = 0; dx < scale; ++dx) {
                    for (int dy = 0; dy < scale; ++dy) {
                        draw_pixel(handle, x + column * scale + dx, y + row * scale + dy);
                    }
                }
            }
        }
    }
}

void ssd1306_hline(ssd1306_handle_t handle, int x, int y, int width)
{
    if (handle == NULL) {
        return;
    }
    for (int i = 0; i < width; i++) {
        draw_pixel(handle, x + i, y);
    }
}

void ssd1306_invert_rect(ssd1306_handle_t handle, int x, int y, int width, int height)
{
    if (handle == NULL) {
        return;
    }
    for (int yy = y; yy < y + height; yy++) {
        for (int xx = x; xx < x + width; xx++) {
            if (xx >= 0 && xx < OLED_WIDTH && yy >= 0 && yy < OLED_HEIGHT) {
                handle->framebuffer[(yy / 8) * OLED_WIDTH + xx] ^= (uint8_t)(1U << (yy % 8));
            }
        }
    }
}

void ssd1306_show(ssd1306_handle_t handle)
{
    if (handle == NULL) {
        return;
    }
    const uint8_t window[] = {0x21, 0, OLED_WIDTH - 1, 0x22, 0, 7};
    esp_err_t err = send_commands(handle, window, sizeof(window));
    uint8_t data[OLED_WIDTH + 1];
    data[0] = 0x40;
    for (int page = 0; err == ESP_OK && page < OLED_HEIGHT / 8; ++page) {
        memcpy(&data[1], &handle->framebuffer[page * OLED_WIDTH], OLED_WIDTH);
        err = i2c_master_transmit(handle->i2c, data, sizeof(data), OLED_TIMEOUT_MS);
    }
    if (err != ESP_OK) {
        ESP_LOGE(TAG, "Display update failed: %s", esp_err_to_name(err));
    }
}
