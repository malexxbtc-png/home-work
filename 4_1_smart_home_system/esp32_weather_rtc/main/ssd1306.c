#include <string.h>
#include "ssd1306.h"
#include "esp_log.h"

static const char *TAG = "ssd1306";

/* Шрифт 5x7, ASCII 0x20..0x7E, по 5 байт на символ (стовпці, біт0 = верх) */
static const uint8_t font5x7[95][5] = {
    {0x00,0x00,0x00,0x00,0x00}, /* ' ' */
    {0x00,0x00,0x5F,0x00,0x00}, /* ! */
    {0x00,0x07,0x00,0x07,0x00}, /* " */
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    {0x02,0x01,0x02,0x04,0x02}, /* ~ */
};

#define FB_SIZE (SSD1306_WIDTH * SSD1306_HEIGHT / 8)

static i2c_master_dev_handle_t s_dev;
/* перший байт = control byte 0x40 (дані), далі сам кадр */
static uint8_t s_buf[1 + FB_SIZE];
#define FB (s_buf + 1)

static esp_err_t send_cmds(const uint8_t *cmds, size_t n)
{
    uint8_t tmp[16];
    if (n + 1 > sizeof(tmp)) {
        return ESP_ERR_INVALID_SIZE;
    }
    tmp[0] = 0x00; /* control byte: команди */
    memcpy(&tmp[1], cmds, n);
    return i2c_master_transmit(s_dev, tmp, n + 1, 100);
}

esp_err_t ssd1306_init(i2c_master_bus_handle_t bus, uint8_t addr)
{
    i2c_device_config_t cfg = {
        .dev_addr_length = I2C_ADDR_BIT_LEN_7,
        .device_address = addr,
        .scl_speed_hz = 400000,
    };
    esp_err_t err = i2c_master_bus_add_device(bus, &cfg, &s_dev);
    if (err != ESP_OK) {
        return err;
    }

    s_buf[0] = 0x40;

    static const uint8_t init_seq[][3] = {
        {0xAE, 0, 0},          /* display off */
        {0xD5, 0x80, 1},       /* clock div */
        {0xA8, 0x3F, 1},       /* mux ratio 64 */
        {0xD3, 0x00, 1},       /* display offset */
        {0x40, 0, 0},          /* start line 0 */
        {0x8D, 0x14, 1},       /* charge pump on */
        {0x20, 0x00, 1},       /* horizontal addressing */
        {0xA1, 0, 0},          /* segment remap */
        {0xC8, 0, 0},          /* COM scan reversed */
        {0xDA, 0x12, 1},       /* COM pins */
        {0x81, 0xCF, 1},       /* contrast */
        {0xD9, 0xF1, 1},       /* precharge */
        {0xDB, 0x40, 1},       /* VCOMH */
        {0xA4, 0, 0},          /* resume from RAM */
        {0xA6, 0, 0},          /* normal (not inverted) */
        {0xAF, 0, 0},          /* display on */
    };

    for (size_t i = 0; i < sizeof(init_seq) / sizeof(init_seq[0]); i++) {
        uint8_t c[2] = { init_seq[i][0], init_seq[i][1] };
        err = send_cmds(c, init_seq[i][2] ? 2 : 1);
        if (err != ESP_OK) {
            ESP_LOGE(TAG, "init cmd 0x%02X failed: %s", c[0], esp_err_to_name(err));
            return err;
        }
    }

    ssd1306_clear();
    return ssd1306_flush();
}

void ssd1306_clear(void)
{
    memset(FB, 0, FB_SIZE);
}

void ssd1306_pixel(int x, int y, bool on)
{
    if (x < 0 || x >= SSD1306_WIDTH || y < 0 || y >= SSD1306_HEIGHT) {
        return;
    }
    uint8_t *p = &FB[x + (y / 8) * SSD1306_WIDTH];
    if (on) {
        *p |= (1 << (y & 7));
    } else {
        *p &= ~(1 << (y & 7));
    }
}

static void draw_char(int x, int y, char c, int scale)
{
    if (c < 0x20 || c > 0x7E) {
        c = '?';
    }
    const uint8_t *glyph = font5x7[c - 0x20];
    for (int col = 0; col < 5; col++) {
        for (int row = 0; row < 7; row++) {
            if (glyph[col] & (1 << row)) {
                for (int dx = 0; dx < scale; dx++) {
                    for (int dy = 0; dy < scale; dy++) {
                        ssd1306_pixel(x + col * scale + dx, y + row * scale + dy, true);
                    }
                }
            }
        }
    }
}

int ssd1306_string_width(const char *s, int scale)
{
    int n = (int)strlen(s);
    return n ? n * 6 * scale - scale : 0;
}

int ssd1306_draw_string(int x, int y, const char *s, int scale)
{
    int cx = x;
    for (; *s; s++) {
        draw_char(cx, y, *s, scale);
        cx += 6 * scale;
    }
    return cx - x - scale;
}

void ssd1306_draw_centered(int y, const char *s, int scale)
{
    int w = ssd1306_string_width(s, scale);
    ssd1306_draw_string((SSD1306_WIDTH - w) / 2, y, s, scale);
}

esp_err_t ssd1306_flush(void)
{
    const uint8_t addr_cmds[] = { 0x21, 0, SSD1306_WIDTH - 1,   /* column range */
                                  0x22, 0, (SSD1306_HEIGHT / 8) - 1 }; /* page range */
    esp_err_t err = send_cmds(addr_cmds, sizeof(addr_cmds));
    if (err != ESP_OK) {
        return err;
    }
    return i2c_master_transmit(s_dev, s_buf, sizeof(s_buf), 200);
}
