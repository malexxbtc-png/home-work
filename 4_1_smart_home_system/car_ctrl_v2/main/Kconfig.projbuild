## esp32s3_node/components/link_pico/Kconfig
```kconfig
menu "ESP32-S3 to master link"

config WEATHER_LINK_PICO_UART_TX_PIN
    int "UART TX GPIO (-> master GPIO16)"
    range 0 48
    default 17

config WEATHER_LINK_PICO_UART_RX_PIN
    int "UART RX GPIO (<- master GPIO17)"
    range 0 48
    default 18

config WEATHER_LINK_PICO_IRQ_PIN
    int "Master interrupt GPIO (optional)"
    range 0 48
    default 16

config WEATHER_LINK_PICO_UART_BAUD_RATE
    int "UART baud rate"
    range 1200 3000000
    default 115200

config WEATHER_LINK_PICO_UART_BUFFER_SIZE
    int "UART receive buffer size (bytes)"
    range 256 4096
    default 1024

config WEATHER_LINK_PICO_TX_BUFFER_SIZE
    int "UART transmit buffer size (bytes)"
    range 256 4096
    default 1536

config WEATHER_LINK_PICO_MAX_JSON_SIZE
    int "Maximum JSON message size (bytes)"
    range 256 2048
    default 1024
    help
        Longest JSON body in either direction. The weather message from the
        master (three days) is about 330 bytes, seven days about 560.

config WEATHER_LINK_PICO_RX_TIMEOUT_MS
    int "UART read timeout (ms)"
    range 10 1000
    default 100

config WEATHER_LINK_PICO_MUTEX_TIMEOUT_MS
    int "Data mutex timeout (ms)"
    range 1 1000
    default 50

config WEATHER_LINK_PICO_DATA_STALE_TIMEOUT_MS
    int "Mark master data stale after (ms)"
    range 1000 600000
    default 15000

config WEATHER_LINK_PICO_IRQ_PULSE_MS
    int "Master interrupt pulse (ms)"
    range 1 1000
    default 10

endmenu
```

## esp32s3_node/components/sd_card/Kconfig
```kconfig
menu "Weather SD card"

config WEATHER_SD_SHARED_BUS
    bool "SD shares the display SPI2 bus (SCK=39, MOSI=38 as the TFT)"
    default n
    help
        n: SD has its own SPI3 bus on the SCK/MOSI/MISO pins below (default).
        y: SD wires to the TFT SCK (GPIO39) and MOSI (GPIO38); only MISO and CS
           are separate. SCK/MOSI options below are then ignored. Use this if
           the card worked on the shared wiring and does not on SPI3.

config WEATHER_SD_CS_PIN
    int "SD card CS GPIO (own SPI3 bus)"
    range 0 48
    default 21

config WEATHER_SD_SCK_PIN
    int "SD card SCK GPIO"
    range 0 48
    default 45

config WEATHER_SD_MOSI_PIN
    int "SD card MOSI GPIO"
    range 0 48
    default 3

config WEATHER_SD_MISO_PIN
    int "SD card MISO GPIO"
    range 0 48
    default 40

config WEATHER_SD_MAX_FREQ_KHZ
    int "SD SPI clock (kHz)"
    range 400 20000
    default 10000

config WEATHER_SD_RETRY_INTERVAL_S
    int "Retry mounting a missing card every (seconds)"
    range 5 3600
    default 60

config WEATHER_SD_DEBUG
    bool "Debug: read sector 0 every 500 ms and log when the card stops responding"
    default n

endmenu
```

## esp32s3_node/sdkconfig.defaults
```kconfig
CONFIG_ESPTOOLPY_FLASHSIZE_16MB=y
CONFIG_SPIRAM=y
CONFIG_SPIRAM_MODE_OCT=y
CONFIG_SPIRAM_SPEED_80M=y


CONFIG_LV_COLOR_16_SWAP=y
CONFIG_LV_FONT_MONTSERRAT_10=y
CONFIG_LV_FONT_MONTSERRAT_12=y
CONFIG_LV_FONT_MONTSERRAT_14=y
CONFIG_LV_FONT_MONTSERRAT_28=y


CONFIG_MBEDTLS_CERTIFICATE_BUNDLE=y
```

## esp_32s3_v_3/components/forecast/Kconfig
```kconfig
menu "Weather forecast"

config WEATHER_FORECAST_WIFI_SSID
    string "Wi-Fi SSID"
    default ""
    help
        Wi-Fi network name used by the forecast component.

config WEATHER_FORECAST_WIFI_PASSWORD
    string "Wi-Fi password"
    default ""
    help
        Wi-Fi password. Configure locally; do not commit credentials.

config WEATHER_FORECAST_LATITUDE
    string "Open-Meteo latitude"
    default "49.9935"
    help
        Latitude passed to the Open-Meteo API.

config WEATHER_FORECAST_LONGITUDE
    string "Open-Meteo longitude"
    default "36.2304"
    help
        Longitude passed to the Open-Meteo API.

config WEATHER_FORECAST_TIMEZONE
    string "Open-Meteo timezone"
    default "Europe/Kyiv"
    help
        Timezone passed to the Open-Meteo API.

config WEATHER_FORECAST_POSIX_TZ
    string "POSIX local timezone"
    default "EET-2EEST,M3.5.0/3,M10.5.0/4"
    help
        POSIX TZ string used by the C library for local time and daylight saving.

config WEATHER_FORECAST_SNTP_SERVER
    string "SNTP server"
    default "pool.ntp.org"

config WEATHER_FORECAST_WIFI_CONNECT_TIMEOUT_MS
    int "Wi-Fi connection wait (ms)"
    range 1000 120000
    default 30000

config WEATHER_FORECAST_WIFI_RETRY_INTERVAL_MS
    int "Wi-Fi / weather retry interval (ms)"
    range 1000 600000
    default 30000

config WEATHER_FORECAST_HTTP_TIMEOUT_MS
    int "Open-Meteo HTTP timeout (ms)"
    range 1000 60000
    default 10000

config WEATHER_FORECAST_UPDATE_INTERVAL_MINUTES
    int "Forecast update interval (minutes)"
    range 1 1440
    default 15

config WEATHER_FORECAST_DAYS
    int "Forecast days"
    range 1 7
    default 3

config WEATHER_FORECAST_STALE_AFTER_SECONDS
    int "Mark forecast stale after (seconds)"
    range 1 604800
    default 7200

config WEATHER_FORECAST_HTTP_RESPONSE_BUFFER_SIZE
    int "HTTP response buffer size (bytes)"
    range 1024 16384
    default 4096

config WEATHER_FORECAST_MUTEX_TIMEOUT_MS
    int "Forecast read mutex timeout (ms)"
    range 1 1000
    default 50

config WEATHER_FORECAST_UPDATE_MUTEX_TIMEOUT_MS
    int "Forecast update mutex timeout (ms)"
    range 1 1000
    default 100

endmenu
```

## esp_devkit_master/main/Kconfig.projbuild
```kconfig
menu "Weather master network"

config WEATHER_NET_WIFI_SSID
    string "Wi-Fi SSID"
    default ""
    help
        Wi-Fi network name. Empty = network disabled (the master works
        with the DS1307 only and has no outdoor weather).

config WEATHER_NET_WIFI_PASSWORD
    string "Wi-Fi password"
    default ""
    help
        Wi-Fi password. Configure locally; never commit sdkconfig.

config WEATHER_NET_LATITUDE
    string "Open-Meteo latitude"
    default "49.9935"

config WEATHER_NET_LONGITUDE
    string "Open-Meteo longitude"
    default "36.2304"

config WEATHER_NET_TIMEZONE
    string "Open-Meteo timezone"
    default "Europe/Kyiv"

config WEATHER_NET_POSIX_TZ
    string "POSIX local timezone"
    default "EET-2EEST,M3.5.0/3,M10.5.0/4"
    help
        Used to turn SNTP (UTC) time into local wall time for the DS1307
        and for the ESP32-S3 node.

config WEATHER_NET_SNTP_SERVER
    string "SNTP server"
    default "pool.ntp.org"

config WEATHER_NET_WIFI_CONNECT_TIMEOUT_MS
    int "Wi-Fi connection wait (ms)"
    range 1000 120000
    default 30000

config WEATHER_NET_RETRY_INTERVAL_MS
    int "Retry interval after a failure (ms)"
    range 1000 600000
    default 30000

config WEATHER_NET_HTTP_TIMEOUT_MS
    int "Open-Meteo HTTP timeout (ms)"
    range 1000 60000
    default 10000

config WEATHER_NET_UPDATE_INTERVAL_MINUTES
    int "Forecast update interval (minutes)"
    range 1 1440
    default 15

config WEATHER_NET_FORECAST_DAYS
    int "Forecast days"
    range 1 7
    default 3

config WEATHER_NET_HTTP_BUFFER_SIZE
    int "HTTP response buffer size (bytes)"
    range 2048 16384
    default 4096

endmenu
```
