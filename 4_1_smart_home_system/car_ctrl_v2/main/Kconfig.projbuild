## 4_1_smart_home_system/car_ctrl_v2/main/Kconfig.projbuild
```kconfig
menu "Car control"

    menu "Pins (ESP32-S3)"
        config CAR_L298_ENA_GPIO
            int "L298N ENA (PWM)"
            default 4
        config CAR_L298_IN1_GPIO
            int "L298N IN1"
            default 5
        config CAR_L298_IN2_GPIO
            int "L298N IN2"
            default 6
        config CAR_MOTOR_REVERSE
            bool "Реверс мотора: L298N (IN1/IN2). Вимкніть для одного MOSFET (тільки вперед)"
            default y
        config CAR_STEER_IN1_GPIO
            int "ULN2003 IN1"
            default 7
        config CAR_STEER_IN2_GPIO
            int "ULN2003 IN2"
            default 8
        config CAR_STEER_IN3_GPIO
            int "ULN2003 IN3"
            default 9
        config CAR_STEER_IN4_GPIO
            int "ULN2003 IN4"
            default 10
        config CAR_MAX_MOSI_GPIO
            int "MAX7219 DIN (MOSI)"
            default 13
        config CAR_MAX_CLK_GPIO
            int "MAX7219 CLK"
            default 14
        config CAR_MAX_CS_GPIO
            int "MAX7219 CS"
            default 15
        config CAR_UART_TX_GPIO
            int "Телеметрія: TX GPIO (не використовується)"
            default 16
        config CAR_UART_RX_GPIO
            int "Телеметрія: RX GPIO (до TX погодної станції)"
            default 17
    endmenu

    menu "Drive motor"
        config CAR_PWM_FREQ_HZ
            int "PWM частота L298N, Гц"
            default 20000
        config CAR_MOTOR_MIN_DUTY_PCT
            int "Мінімальна шпаруватість старту, %"
            range 0 99
            default 30
            help
                Мотор не стартує на малій напрузі. Ненульова тяга 1..100 мапиться на
                діапазон від цього значення до CAR_MOTOR_MAX_DUTY_PCT. Підберіть тестом.
        config CAR_MOTOR_MAX_DUTY_PCT
            int "Максимальна шпаруватість (повна тяга), %"
            range 1 100
            default 60
            help
                Обмежує напругу на моторі. Вихід L298N приблизно VS·шпаруватість − 2 В.
                Для мотора 5 В і VS 12 В: 60 % дає ~5 В. Для VS 6 В ставте 100.
    endmenu

    menu "Steering (28BYJ-48)"
        config CAR_STEER_HALFSTEPS_PER_REV
            int "Half-steps на оберт вихідного валу"
            default 4096
            help
                28BYJ-48 з редуктором 1:64 у half-step режимі = 4096 (номінал).
                Реальне передатне відношення ~1:63.68, тож для точного кута
                підберіть значення тестом (часто ~4076).
        config CAR_STEER_MAX_DEG
            int "Максимальний кут керма, градуси (360 = повний оберт у кожен бік)"
            range 1 360
            default 360
        config CAR_STEER_VECTOR_MIN_PCT
            int "Мінімальна довжина вектора стіка для керма, %"
            range 0 100
            default 40
        config CAR_STEER_STEP_DELAY_MS
            int "Пауза між півкроками, мс"
            range 1 20
            default 2
        config CAR_STEER_AXIS
            bool "Кермо за віссю X (центр = 0°). Вимкніть для режиму за вектором стіка"
            default y
        config CAR_STEER_INVERT
            bool "Інвертувати напрямок керма (якщо крутить навпаки)"
            default n
    endmenu

    menu "UART"
        config CAR_UART_PORT
            int "Телеметрія (погодна станція): UART номер"
            default 1
        config CAR_UART_BAUD
            int "Телеметрія: швидкість, бод"
            default 115200
        config CAR_CMD_UART_PORT
            int "Команди (ESP32 DevKit): UART номер"
            default 2
        config CAR_CMD_UART_RX_GPIO
            int "Команди: RX GPIO (до TX DevKit)"
            default 21
        config CAR_CMD_UART_TX_GPIO
            int "Команди: TX GPIO (-1 = не потрібен)"
            default -1
        config CAR_CMD_UART_BAUD
            int "Команди: швидкість, бод"
            default 115200
    endmenu

    menu "Display and safety"
        config CAR_MATRIX_INTENSITY
            int "Яскравість MAX7219 (0..15)"
            range 0 15
            default 4
        config CAR_SCROLL_MS
            int "Крок прокрутки, мс"
            default 120
        config CAR_FAILSAFE_MS
            int "Failsafe: стоп тяги, якщо немає команди M: довше, мс"
            default 1000
    endmenu

    menu "Joystick (ESP32-S3)"
        config CAR_JOY_ENABLE
            bool "Керування з джойстика (M:/S: з UART ігноруються)"
            default y
        config CAR_JOY_X_GPIO
            int "Вісь X (кермо), ADC1: GPIO 1..10"
            range 1 10
            default 1
        config CAR_JOY_Y_GPIO
            int "Вісь Y (тяга), ADC1: GPIO 1..10"
            range 1 10
            default 2
        config CAR_JOY_SW_GPIO
            int "Кнопка стіка: стоп тяги (-1 = немає)"
            default 38
        config CAR_JOY_DEADZONE
            int "Мертва зона, сирі одиниці 0..4095"
            range 0 1000
            default 150
        config CAR_JOY_INVERT_Y
            bool "Інвертувати вісь Y (тяга)"
            default n
        config CAR_JOY_INVERT_X
            bool "Інвертувати вісь X (кермо)"
            default n
    endmenu

endmenu
```

## 4_1_smart_home_system/esp32_weather_rtc/main/Kconfig.projbuild
```kconfig
                                                                                menu "Weather station"

    config WS_WIFI_ENABLE
        bool "Увімкнути WiFi + NTP (підстроювання RTC раз на годину)"
        default y
        help
            Годинник іде від DS1307 і без WiFi. З WiFi RTC додатково
            синхронізується з інтернетом.

    config WS_WIFI_SSID
        string "SSID WiFi мережі"
        default "your ssid"

    config WS_WIFI_PASSWORD
        string "Пароль WiFi мережі"
        default "your password"

    config WS_TIMEZONE
        string "POSIX timezone"
        default "EET-2EEST,M3.5.0/3,M10.5.0/4"
        help
            Київ: EET-2EEST,M3.5.0/3,M10.5.0/4 (автоматичний літній/зимовий час)

    config WS_I2C_SDA
        int "I2C SDA GPIO"
        default 21

    config WS_I2C_SCL
        int "I2C SCL GPIO"
        default 22

    config WS_RTC_ADDR
        hex "DS1307 I2C address"
        default 0x68

    config WS_RTC_SET_FROM_BUILD
        bool "Примусово записати в RTC час збірки (одноразово)"
        default n
        help
            Звичайно RTC виставляється сам: від NTP або (якщо RTC ще не заведений) часом збірки.
            Увімкни, прошийся один раз, потім ВИМКНИ і прошийся знову.

    config WS_OLED_ADDR
        hex "OLED I2C address"
        default 0x3C
        help
            0x3C або 0x3D

    config WS_SENSOR_ADDR
        hex "BMP280/BME280 I2C address"
        default 0x76
        help
            0x76 або 0x77. Якщо датчик не знайдено, код сам спробує другу адресу.

    config WS_UART_TX
        int "UART2 TX GPIO (до RX на ESP32-S3)"
        default 17

    config WS_UART_RX
        int "UART2 RX GPIO"
        default 16

    config WS_UART_BAUD
        int "UART baud rate"
        default 115200

    config WS_SHORT_SCREEN_MS
        int "Тривалість екранів температури/вологості/тиску, мс"
        default 3000
        help
            Екран часу показується в 4 рази довше.

endmenu
```

## 4_2_3_ws/esp32_weather/main/Kconfig.projbuild
```kconfig
menu "Weather station"

    config WS_WIFI_ENABLE
        bool "Enable WiFi (NTP time + forecast)"
        default y

    config WS_WIFI_SSID
        string "WiFi SSID"
        default "YOUR_WIFI_SSID"
        depends on WS_WIFI_ENABLE

    config WS_WIFI_PASSWORD
        string "WiFi password"
        default ""
        depends on WS_WIFI_ENABLE

    config WS_TIMEZONE
        string "POSIX timezone"
        default "EET-2EEST,M3.5.0/3,M10.5.0/4"

    config WS_I2C_SDA
        int "I2C SDA GPIO (OLED, BMP/BME280, DS1307)"
        default 21

    config WS_I2C_SCL
        int "I2C SCL GPIO"
        default 22

    config WS_RTC_ADDR
        hex "DS1307 I2C address"
        default 0x68

    config WS_RTC_SET_FROM_BUILD
        bool "If the RTC is not set and there is no WiFi/GPS, use the build time"
        default y

    config WS_OLED_ADDR
        hex "SSD1306 I2C address"
        default 0x3C

    config WS_SENSOR_ADDR
        hex "BMP280/BME280 I2C address"
        default 0x76

    config WS_UART_TX
        int "UART2 TX GPIO (to ESP32-S3 RX)"
        default 17

    config WS_UART_RX
        int "UART2 RX GPIO (reserved)"
        default 16

    config WS_UART_BAUD
        int "UART2 baud rate"
        default 115200

    config WS_UART_EXTRA
        bool "Also send $GEO and $FCST lines (location + forecast) to the ESP32-S3"
        default n

    config WS_SHORT_SCREEN_MS
        int "Duration of a short screen (ms); the clock screen is 4x longer"
        default 3000

    config WS_GPS_RX
        int "GPS: ESP32 RX GPIO (connect to GP-01 TX)"
        default 25

    config WS_GPS_TX
        int "GPS: ESP32 TX GPIO (connect to GP-01 RX)"
        default 26

    config WS_GPS_EN
        int "GPS power-enable GPIO via MOSFET (-1 = always powered)"
        default -1

    config WS_PIR_GPIO
        int "PIR (AM312) output GPIO, must be an RTC GPIO for wakeup"
        default 33

    config WS_INACTIVITY_S
        int "Seconds without motion before deep sleep"
        default 300

    config WS_FORECAST_REFRESH_MIN
        int "Forecast refresh interval (minutes)"
        default 30

endmenu
```

## esp32s3_node/components/camera/Kconfig
```kconfig
menu "Weather camera (OV7670)"

config WEATHER_CAMERA_ENABLED
    bool "Enable the camera"
    default y

config WEATHER_CAMERA_INIT_AT_BOOT
    bool "Initialise the camera at boot (otherwise on the first snapshot request)"
    default y
    depends on WEATHER_CAMERA_ENABLED

menu "Pins"
    depends on WEATHER_CAMERA_ENABLED

config WEATHER_CAM_PIN_PWDN
    int "PWDN GPIO (-1 = not connected, tie the module pin to GND)"
    range -1 48
    default -1
config WEATHER_CAM_PIN_RESET
    int "RESET GPIO (-1 = not connected, tie the module pin RET to 3V3)"
    range -1 48
    default -1
config WEATHER_CAM_PIN_XCLK
    int "XCLK GPIO"
    range 0 48
    default 15
config WEATHER_CAM_PIN_SIOD
    int "SIOD (SCCB SDA) GPIO"
    range 0 48
    default 4
config WEATHER_CAM_PIN_SIOC
    int "SIOC (SCCB SCL) GPIO"
    range 0 48
    default 5
config WEATHER_CAM_PIN_VSYNC
    int "VSYNC GPIO"
    range 0 48
    default 6
config WEATHER_CAM_PIN_HREF
    int "HREF GPIO"
    range 0 48
    default 7
config WEATHER_CAM_PIN_PCLK
    int "PCLK GPIO"
    range 0 48
    default 13
config WEATHER_CAM_PIN_D0
    int "D0 GPIO"
    range 0 48
    default 11
config WEATHER_CAM_PIN_D1
    int "D1 GPIO"
    range 0 48
    default 9
config WEATHER_CAM_PIN_D2
    int "D2 GPIO"
    range 0 48
    default 8
config WEATHER_CAM_PIN_D3
    int "D3 GPIO"
    range 0 48
    default 10
config WEATHER_CAM_PIN_D4
    int "D4 GPIO"
    range 0 48
    default 12
config WEATHER_CAM_PIN_D5
    int "D5 GPIO"
    range 0 48
    default 14
config WEATHER_CAM_PIN_D6
    int "D6 GPIO"
    range 0 48
    default 1
config WEATHER_CAM_PIN_D7
    int "D7 GPIO"
    range 0 48
    default 2
endmenu

config WEATHER_CAM_XCLK_MHZ
    int "XCLK frequency (MHz)"
    range 5 20
    default 10
    depends on WEATHER_CAMERA_ENABLED
    help
        10 MHz is more tolerant of long jumper wires than 20 MHz. If frames come out short
        ("cam_hal: FB-SIZE ... !=" in the log), try 20 MHz with short wires.

choice WEATHER_CAM_FRAME
    prompt "Snapshot resolution"
    default WEATHER_CAM_FRAME_QVGA
    depends on WEATHER_CAMERA_ENABLED
config WEATHER_CAM_FRAME_QVGA
    bool "QVGA 320x240"
config WEATHER_CAM_FRAME_VGA
    bool "VGA 640x480"
endchoice

config WEATHER_CAM_JPEG_QUALITY
    int "JPEG quality (1-100, higher is better)"
    range 10 100
    default 85
    depends on WEATHER_CAMERA_ENABLED

config WEATHER_CAM_WARMUP_FRAMES
    int "Frames to discard before the snapshot (auto exposure settling)"
    range 0 20
    default 8
    depends on WEATHER_CAMERA_ENABLED

config WEATHER_CAM_POWER_DOWN
    bool "Stop the camera clock (XCLK) between snapshots"
    default y
    depends on WEATHER_CAMERA_ENABLED
    help
        XCLK is a fast clock that can couple into long SD-card wires and break SPI reads.
        With this option the camera is started for each snapshot and stopped before writing to the SD.

config WEATHER_CAM_HFLIP
    bool "Mirror horizontally"
    default n
    depends on WEATHER_CAMERA_ENABLED

config WEATHER_CAM_VFLIP
    bool "Flip vertically"
    default n
    depends on WEATHER_CAMERA_ENABLED

config WEATHER_CAM_SWAP_BYTES
    bool "Swap bytes of RGB565 pixels (try this if colours look wrong)"
    default n
    depends on WEATHER_CAMERA_ENABLED

config WEATHER_CAM_MIN_FREE_MB
    int "Delete the oldest photo folders when free SD space is below (MB)"
    range 8 8192
    default 200
    depends on WEATHER_CAMERA_ENABLED

endmenu
```

## esp32s3_node/components/display/Kconfig
```kconfig
menu "Weather display (ST7789P3 76x284)"

config WEATHER_DISPLAY_PIN_SCLK
    int "TFT SCK GPIO"
    range 0 48
    default 39

config WEATHER_DISPLAY_PIN_MOSI
    int "TFT MOSI (SDA) GPIO"
    range 0 48
    default 38
    help
        The on-board RGB LED sits on GPIO48 (older boards) or GPIO38 (v1.1).
        If it blinks with the display, move this pin to the other one.

config WEATHER_DISPLAY_PIN_CS
    int "TFT CS GPIO"
    range 0 48
    default 41

config WEATHER_DISPLAY_PIN_DC
    int "TFT DC GPIO"
    range 0 48
    default 42

config WEATHER_DISPLAY_PIN_RST
    int "TFT RST GPIO"
    range 0 48
    default 47

config WEATHER_DISPLAY_GAP_X
    int "Panel gap X (landscape)"
    range 0 320
    default 18
    help
        Offset of the visible area in controller RAM along the long (284 px)
        axis after swap_xy. If the picture is shifted, swap GAP_X and GAP_Y.

config WEATHER_DISPLAY_GAP_Y
    int "Panel gap Y (landscape)"
    range 0 320
    default 82

config WEATHER_DISPLAY_INVERT_COLORS
    bool "Invert colours"
    default y
    help
        Most IPS ST7789 panels need colour inversion. Disable it if the
        colours look negative.

endmenu
```

## esp32s3_node/components/forecast/Kconfig
```kconfig
menu "Weather data from master"

config WEATHER_FORECAST_STALE_AFTER_SECONDS
    int "Mark weather stale after (seconds)"
    range 60 604800
    default 7200
    help
        Weather is fetched by the master. If its age (reported by the master)
        exceeds this value, the display greys the outside temperature.

config WEATHER_FORECAST_MUTEX_TIMEOUT_MS
    int "Weather cache mutex timeout (ms)"
    range 1 1000
    default 50

endmenu
```
