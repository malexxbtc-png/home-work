#include "ssd1306.h"

#include <string.h>
#include "esp_check.h"
#include "esp_log.h"
#include "i2c_bus.h"

static const char *TAG = "ssd1306";

static i2c_master_dev_handle_t s_dev;
static uint8_t s_fb[OLED_W * OLED_H / 8];   /* 8 pages x 128 columns, bit0 = top pixel */

/* Classic 5x7 font, ASCII 0x20..0x7E, 5 column bytes per glyph. */
static const uint8_t FONT[95][5] = {
    {0x00,0x00,0x00,0x00,0x00}, {0x00,0x00,0x5F,0x00,0x00}, {0x00,0x07,0x00,0x07,0x00},
    {0x14,0x7F,0x14,0x7F,0x14}, {0x24,0x2A,0x7F,0x2A,0x12}, {0x23,0x13,0x08,0x64,0x62},
    {0x36,0x49,0x55,0x22,0x50}, {0x00,0x05,0x03,0x00,0x00}, {0x00,0x1C,0x22,0x41,0x00},
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    {0x00,0x41,0x36,0x08,0x00}, {0x10,0x08,0x08,0x10,0x08},
};

static esp_err_t send_cmds(const uint8_t *cmds, size_t n)
{
    uint8_t buf[32];
    if (n + 1 > sizeof(buf)) {
        return ESP_ERR_INVALID_SIZE;
    }
    buf[0] = 0x00;                      /* control byte: command stream */
    memcpy(buf + 1, cmds, n);
    return i2c_master_transmit(s_dev, buf, n + 1, 100);
}

esp_err_t ssd1306_init(void)
{
    ESP_RETURN_ON_ERROR(i2c_bus_add(CONFIG_WS_OLED_ADDR, 400000, &s_dev), TAG, "add device");

    static const uint8_t init[] = {
        0xAE,             /* display off */
        0xD5, 0x80,       /* clock divide */
        0xA8, 0x3F,       /* multiplex 1/64 */
        0xD3, 0x00,       /* display offset */
        0x40,             /* start line */
        0x8D, 0x14,       /* charge pump on */
        0x20, 0x00,       /* horizontal addressing */
        0xA1, 0xC8,       /* segment/COM remap (normal orientation) */
        0xDA, 0x12,       /* COM pins */
        0x81, 0xCF,       /* contrast */
        0xD9, 0xF1,       /* pre-charge */
        0xDB, 0x40,       /* VCOMH */
        0xA4, 0xA6,       /* resume from RAM, non-inverted */
        0xAF,             /* display on */
    };
    ESP_RETURN_ON_ERROR(send_cmds(init, sizeof(init)), TAG, "init sequence");
    ssd1306_clear();
    return ssd1306_flush();
}

void ssd1306_clear(void)
{
    memset(s_fb, 0, sizeof(s_fb));
}

static void px(int x, int y)
{
    if (x < 0 || x >= OLED_W || y < 0 || y >= OLED_H) {
        return;
    }
    s_fb[(y >> 3) * OLED_W + x] |= (uint8_t)(1u << (y & 7));
}

static void glyph(int x, int y, int scale, char c)
{
    if (c < 0x20 || c > 0x7E) {
        c = '?';
    }
    const uint8_t *g = FONT[c - 0x20];
    for (int col = 0; col < 5; col++) {
        for (int row = 0; row < 7; row++) {
            if (g[col] & (1u << row)) {
                for (int dx = 0; dx < scale; dx++) {
                    for (int dy = 0; dy < scale; dy++) {
                        px(x + col * scale + dx, y + row * scale + dy);
                    }
                }
            }
        }
    }
}

int ssd1306_text_width(int scale, const char *s)
{
    int n = (int)strlen(s);
    return n ? n * 6 * scale - scale : 0;
}

void ssd1306_text(int x, int y, int scale, const char *s)
{
    for (; *s; s++) {
        glyph(x, y, scale, *s);
        x += 6 * scale;
    }
}

void ssd1306_text_center(int y, int scale, const char *s)
{
    ssd1306_text((OLED_W - ssd1306_text_width(scale, s)) / 2, y, scale, s);
}

void ssd1306_text_right(int y, int scale, const char *s)
{
    ssd1306_text(OLED_W - ssd1306_text_width(scale, s), y, scale, s);
}

void ssd1306_hline(int x, int y, int w)
{
    for (int i = 0; i < w; i++) {
        px(x + i, y);
    }
}

esp_err_t ssd1306_flush(void)
{
    static const uint8_t window[] = {0x21, 0, OLED_W - 1, 0x22, 0, 7};
    ESP_RETURN_ON_ERROR(send_cmds(window, sizeof(window)), TAG, "window");

    uint8_t buf[1 + OLED_W];
    buf[0] = 0x40;                      /* control byte: display data */
    for (int page = 0; page < 8; page++) {
        memcpy(buf + 1, &s_fb[page * OLED_W], OLED_W);
        ESP_RETURN_ON_ERROR(i2c_master_transmit(s_dev, buf, sizeof(buf), 100), TAG, "data");
    }
    return ESP_OK;
}

void ssd1306_power(bool on)
{
    const uint8_t cmd = on ? 0xAF : 0xAE;
    send_cmds(&cmd, 1);
}
